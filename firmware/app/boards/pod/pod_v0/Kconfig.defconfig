## firmware/app/boards/pod/pod_v0/Kconfig.defconfig
```kconfig
# Pod v0 board defaults.

if BOARD_POD_V0

config HW_STACK_PROTECTION
	default ARCH_HAS_STACK_PROTECTION

endif # BOARD_POD_V0
```

## firmware/app/boards/pod/pod_v0/board.yml
```yaml
board:
  name: pod_v0
  full_name: Pod v0 (sport-performance, B-909)
  socs:
    - name: nrf52840
```
